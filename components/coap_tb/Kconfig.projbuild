## components/coap_tb/Kconfig.projbuild
```kconfig
menu "Coap Thigsboard Configuration"


    config PROVISION_KEY_COAP
        string "Provision Key Thingsboard"
        default  "zu1eo2u39gswqdy98jls"
        help
            Provision key del perfil de dispositivo de Thingsboard

    config PROVISION_SECRET_COAP
        string "Provision Secret Thingsboard"
        default "auij6l6olicsoo4w2p7q"
        help
            Provision secret del perfil de dispositivo de Thingsboard

    config SERVER_IP
        string "Server IP"
        default "192.168.1.119"
        help
            IP del servidor CoAP



endmenu
```

## components/mqtt_tb/Kconfig.projbuild
```kconfig
menu "Mqtt Thigsboard Configuration"

    config PROVISION_KEY_MQTT
        string "Provision Key Thingsboard"
        default  "7q3oikap98fej6ogajve"
        help
            Provision key del perfil de dispositivo de Thingsboard

    config PROVISION_SECRET_MQTT
        string "Provision Secret Thingsboard"
        default "wv3nqps7o6udtjfytfiy"
        help
            Provision secret del perfil de dispositivo de Thingsboard

    config BROKER_URL
        string "Broker URL"
        default "mqtts://192.168.1.119:8883"
        help
            URL del broker al que se conecta


endmenu
```

## main/Kconfig.projbuild
```kconfig
menu "Main Configuration"

choice IoT_PROTOCOL
        prompt "Seleccionar Protocolo de Transporte"
        default USE_MQTT
        help
            Selecciona qué protocolo se utilizará para la comunicación con ThingsBoard.

        config USE_MQTT
            bool "Usar MQTT (sobre TLS)"
            help
                Habilita el cliente MQTT. Requiere broker y certificados.

        config USE_COAP
            bool "Usar CoAP (sobre DTLS)"
            help
                Habilita el cliente CoAP. Requiere servidor y certificados.

    endchoice

endmenu
```
